## rpi_3_b_plus_fit_defconfig
```kconfig
CONFIG_ARM=y
CONFIG_ARCH_CPU_INIT=y
CONFIG_ARCH_BCM283X=y
CONFIG_SYS_TEXT_BASE=0x00080000
CONFIG_SYS_LOAD_ADDR=0x00080000
CONFIG_TARGET_RPI_3=y
CONFIG_SYS_MALLOC_F_LEN=0x2000
CONFIG_NR_DRAM_BANKS=1
CONFIG_ENV_SIZE=0x4000
CONFIG_DEFAULT_DEVICE_TREE="bcm2837-rpi-3-b-plus"
CONFIG_DISTRO_DEFAULTS=y
CONFIG_OF_BOARD_SETUP=y
CONFIG_USE_PREBOOT=y
# CONFIG_DISPLAY_CPUINFO is not set
# CONFIG_DISPLAY_BOARDINFO is not set
CONFIG_MISC_INIT_R=y
CONFIG_SYS_PROMPT="U-Boot> "
CONFIG_CMD_GPIO=y
CONFIG_CMD_MMC=y
CONFIG_CMD_USB=y
CONFIG_CMD_FS_UUID=y
CONFIG_CMD_IMI=y
CONFIG_ENV_FAT_DEVICE_AND_PART="0:1"
CONFIG_SYS_RELOC_GD_ENV_ADDR=y
CONFIG_ENV_VARS_UBOOT_RUNTIME_CONFIG=y
CONFIG_TFTP_TSIZE=y
CONFIG_MMC_SDHCI=y
CONFIG_MMC_SDHCI_BCM2835=y
CONFIG_PHYLIB=y
CONFIG_DM_ETH=y
CONFIG_PINCTRL=y
# CONFIG_PINCTRL_GENERIC is not set
# CONFIG_REQUIRE_SERIAL_CONSOLE is not set
CONFIG_SYSINFO=y
CONFIG_SYSINFO_SMBIOS=y
CONFIG_USB=y
CONFIG_USB_DWC2=y
CONFIG_USB_KEYBOARD=y
CONFIG_USB_HOST_ETHER=y
CONFIG_USB_ETHER_LAN78XX=y
CONFIG_USB_ETHER_SMSC95XX=y
CONFIG_DM_VIDEO=y
# CONFIG_VIDEO_BPP8 is not set
# CONFIG_VIDEO_BPP16 is not set
CONFIG_SYS_WHITE_ON_BLACK=y
CONFIG_CONSOLE_SCROLL_LINES=10
CONFIG_PHYS_TO_BUS=y
CONFIG_OF_LIBFDT_OVERLAY=y

# PSCI
# CONFIG_ARMV8_MULTIENTRY is not set
# CONFIG_ARMV8_SET_SMPEN is not set
# CONFIG_ARMV8_SPL_EXCEPTION_VECTORS is not set
# CONFIG_ARMV8_EA_EL3_FIRST is not set
# CONFIG_ARMV8_PSCI is not set
# CONFIG_ARMV8_PSCI_CPUS_PER_CLUSTER is not set
# CONFIG_ARMV8_SECURE_BASE is not set
# CONFIG_ARM_SMCCC is not set
# CONFIG_SYS_HAS_ARMV8_SECURE_BASE

# FDT
CONFIG_OF_CONTROL=y
CONFIG_OF_EMBED=y
# CONFIG_OF_SEPARATE is not set
# CONFIG_OF_BOARD is not set
CONFIG_OF_LIBFDT=y
# CONFIG_SPL_OF_LIBFDT is not set

# Debug
# CONFIG_LOG_MAX_LEVEL is not set

# FIT
CONFIG_FIT=y
CONFIG_FIT_SIGNATURE=y
# CONFIG_IMAGE_FORMAT_LEGACY is not net
CONFIG_FIT_VERBOSE=y
CONFIG_FIT_SIGNATURE_MAX_SIZE=0x20000000

# Crypto Algorithms
CONFIG_RSA=y
CONFIG_RSA_VERIFY=y
CONFIG_ECDSA=y
CONFIG_ECDSA_VERIFY=y
CONFIG_SHA256=y
CONFIG_SHA384=y
CONFIG_SHA512=y

CONFIG_RANDOMIZE_BASE=y

# TPM Specific Config
# CONFIG_HW_RANDOM_TPM is not set
# CONFIG_TCG_TPM is not set
# CONFIG_TCG_TIS_CORE is not set
# CONFIG_TCG_TIS_SPI is not set
# CONFIG_SECURITYFS is not set
```

## v2024.07-rpi_3_b_plus_fit_defconfig
```kconfig
CONFIG_ARM=y
CONFIG_ARCH_CPU_INIT=y
CONFIG_ARCH_BCM283X=y
CONFIG_TEXT_BASE=0x00080000
CONFIG_TARGET_RPI_3=y
CONFIG_NR_DRAM_BANKS=1
CONFIG_HAS_CUSTOM_SYS_INIT_SP_ADDR=y
CONFIG_CUSTOM_SYS_INIT_SP_ADDR=0x7fffe40
CONFIG_ENV_SIZE=0x4000
CONFIG_DEFAULT_DEVICE_TREE="bcm2837-rpi-3-b-plus"
CONFIG_OF_LIBFDT_OVERLAY=y
CONFIG_SYS_LOAD_ADDR=0x1000000
CONFIG_BOOTSTD_DEFAULTS=y
CONFIG_OF_BOARD_SETUP=y
CONFIG_FDT_SIMPLEFB=y
CONFIG_USE_PREBOOT=y
CONFIG_SYS_PBSIZE=1049
# CONFIG_DISPLAY_CPUINFO is not set
# CONFIG_DISPLAY_BOARDINFO is not set
CONFIG_MISC_INIT_R=y
CONFIG_SYS_PROMPT="U-Boot> "
CONFIG_CMD_GPIO=y
CONFIG_CMD_MMC=y
CONFIG_CMD_USB=y
CONFIG_CMD_FS_UUID=y
CONFIG_ENV_FAT_DEVICE_AND_PART="0:1"
CONFIG_SYS_RELOC_GD_ENV_ADDR=y
CONFIG_ENV_VARS_UBOOT_RUNTIME_CONFIG=y
CONFIG_TFTP_TSIZE=y
CONFIG_BCM2835_GPIO=y
CONFIG_MMC_SDHCI=y
CONFIG_MMC_SDHCI_BCM2835=y
CONFIG_PHYLIB=y
CONFIG_PINCTRL=y
# CONFIG_PINCTRL_GENERIC is not set
# CONFIG_REQUIRE_SERIAL_CONSOLE is not set
CONFIG_SYSINFO=y
CONFIG_SYSINFO_SMBIOS=y
CONFIG_USB=y
CONFIG_USB_DWC2=y
CONFIG_USB_KEYBOARD=y
CONFIG_USB_HOST_ETHER=y
CONFIG_USB_ETHER_LAN78XX=y
CONFIG_USB_ETHER_SMSC95XX=y
CONFIG_VIDEO=y
# CONFIG_VIDEO_BPP8 is not set
# CONFIG_VIDEO_BPP16 is not set
CONFIG_SYS_WHITE_ON_BLACK=y
CONFIG_VIDEO_BCM2835=y
CONFIG_CONSOLE_SCROLL_LINES=10
CONFIG_PHYS_TO_BUS=y

CONFIG_SYS_UBOOT_START=0x11000000

CONFIG_FIT=y
CONFIG_FIT_EXTERNAL_OFFSET=0x0
CONFIG_FIT_FULL_CHECK=y
CONFIG_FIT_SIGNATURE=y
CONFIG_FIT_SIGNATURE_MAX_SIZE=0x20000000
CONFIG_FIT_RSASSA_PSS=y
CONFIG_FIT_VERBOSE=y
CONFIG_FIT_BEST_MATCH=y
CONFIG_FIT_PRINT=y
CONFIG_LEGACY_IMAGE_FORMAT=y
# CONFIG_SPL_LOAD_FIT_FULL is not set

CONFIG_OF_CONTROL=y
CONFIG_OF_REAL=y
CONFIG_OF_SEPARATE=y
CONFIG_OF_BOARD=y
CONFIG_OF_PRIOR_STAGE=y
CONFIG_OF_OMIT_DTB=y
CONFIG_DEVICE_TREE_INCLUDES=""
CONFIG_OF_LIST="bcm2837-rpi-3-b-plus"
CONFIG_DEFAULT_FDT_FILE="bcm2837-rpi-3-b-plus.dtb"
CONFIG_SYS_FDT_PAD=0x8000

CONFIG_ECDSA=y
CONFIG_ECDSA_VERIFY=y
CONFIG_RSA=y
CONFIG_RSA_VERIFY=y

CONFIG_HASH=y
CONFIG_SHA256=y
CONFIG_SHA384=y
CONFIG_SHA512=y

CONFIG_OF_LIBFDT=y

CONFIG_STACKPROTECTOR=y
CONFIG_ARMV8_PSCI=y
CONFIG_ARMV8_PSCI_NR_CPUS=4
CONFIG_ARMV8_PSCI_CPUS_PER_CLUSTER=0
```
